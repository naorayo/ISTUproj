.include "m128def.inc"; Подключение заголовочного файла с адресами и именами регистров
;.device ATmega128
.def temp = r16; Задаем имена РОНам
.def sys = r17;
.def razr1 = r18;
.def razr2 = r19;

.dseg; Здесь задаём ячейки оперативной памяти
.org $0100; константа в ОЗУ
const1: .byte $0F;

.cseg; Программный сегмент
.org 0;Указатель на вектор
rjmp Reset; Переход к метке Reset

.org $0002 jmp EXT_INT0; Указатель на вектор внешних прерываний 0
.org $0004 jmp EXT_INT1; Указатель на вектор внешних прерываний 1
.org $0006 jmp EXT_INT2; Указатель на вектор внешних прерываний 2

.org $001C jmp TIM1_OVF; Указатель на вектор прерываний по перполнению таймера 1

.org $001F;

Reset: ;метка Reset
ldi temp, high(RAMEND);Инициализация стека
out sph, temp;Вершина
ldi temp, low(RAMEND)
out spl, temp;Низ

ldi temp, 0xff; Записываем число 0xff в регистр с именем temp
out DDRB, temp; Порт B - выход

out DDRA, temp;
ldi temp, 0x00;
out PINA, temp; Порт A - вход
ldi temp, 0xff
out PORTA, temp

ldi razr2,0b01000000
out GICR, razr2; в общий регистр управления прерываниями
ldi temp, 0b00000001
out MCUCR, razr2; в регистр управления вычислительного ядра

ldi temp,0b00000101; Предделитель на 1024
out TCCR1B, temp; Частота 8кГц

ldi temp,0b00000100; Установка 3 бита
out TIFR, temp; в регистр флага прерываний
out TIMSK, temp; в регистр маски прерываний

ldi temp,0xf0; Запись числа
out TCNT1H,temp;  в вершину
out TCNT1L,temp; и низ стека

ldi sys, 0b10000000; Уставка для последующего сравнения и реализации "бегущего огня"

sei; Установка бита i в регистре SREG (Разрешение прерываний)

Program:
rjmp Program

EXT_INT0: ;Внешнее прерывание 0
cli; Очистка бита i в регистре SREG (Запрет прерываний)
ldi temp, 0xF2
sei; Установка бита i в регистре SREG (Разрешение прерываний)
reti; Выход из прерывания

EXT_INT1: ;Внешнее прерывание 1
cli; Очистка бита i в регистре SREG (Запрет прерываний)
ldi temp, 0xE2
sei; Установка бита i в регистре SREG (Разрешение прерываний)
reti; Выход из прерывания

EXT_INT2: ;Внешнее прерывание 2
cli; Очистка бита i в регистре SREG (Запрет прерываний)
ldi temp, 0xD2
sei; Установка бита i в регистре SREG (Разрешение прерываний)
reti; Выход из прерывания

TIM1_OVF: ; Прерывание по переполненю таймера- счетчика 1
cli; Очистка бита i в регистре SREG (Запрет прерываний)

cpi sys, 0b10000000; Сравнение sys и числа 0b00000001
breq Di2; Если равно, переходим

cpi sys, 0b01000000; Сравнение sys и числа 0b00000010
breq Di3; Если равно, переходим

cpi sys, 0b00100000; Сравнение sys и числа 0b00000100
breq Di4; Если равно, переходим

cpi sys, 0b00010000; Сравнение sys и числа 0b00001000
breq Di5; Если равно, переходим

cpi sys, 0b00001000; Сравнение sys и числа 0b00010000
breq Di6; Если равно, переходим

cpi sys, 0b00000100; Сравнение sys и числа 0b00100000
breq Di7; Если равно, переходим

cpi sys, 0b00000010; Сравнение sys и числа 0b01000000
breq Di8; Если равно, переходим

cpi sys, 0b00000001; Сравнение sys и числа 0b10000000
breq Di1; Если равно, переходим

Vix:
ldi temp, 0xEE; В temp - число 0xEE
out TCNT1H,temp; Записываем число на вершину стека
out TCNT1L,temp; Это же число в низ стека - для изменения скорости работы таймера
sei; Установка бита i в регистре SREG (Разрешение прерываний)
reti; Выход из прерывания

Di1:
ldi sys, 0b10000000; Подаем единицу на один из выводов порта B
out PORTB, sys; Вследствие чего загорается светодиод
rjmp Vix; Возврат в Vix

Di2:
ldi sys, 0b01000000; Подаем единицу на один из выводов порта B
out PORTB, sys; Вследствие чего загорается светодиод
rjmp Vix; Возврат в Vix

Di3:
ldi sys, 0b00100000; Подаем единицу на один из выводов порта B
out PORTB, sys; Вследствие чего загорается светодиод
rjmp Vix; Возврат в Vix

Di4:
ldi sys, 0b00010000; Подаем единицу на один из выводов порта B
out PORTB, sys; Вследствие чего загорается светодиод
rjmp Vix; Возврат в Vix

Di5:
ldi sys, 0b00001000; Подаем единицу на один из выводов порта B
out PORTB, sys; Вследствие чего загорается светодиод
rjmp Vix; Возврат в Vix

Di6:
ldi sys, 0b00000100; Подаем единицу на один из выводов порта B
out PORTB, sys; Вследствие чего загорается светодиод
rjmp Vix; Возврат в Vix

Di7:
ldi sys, 0b00000010; Подаем единицу на один из выводов порта B
out PORTB, sys; Вследствие чего загорается светодиод
rjmp Vix; Возврат в Vix

Di8:
ldi sys, 0b00000001; Подаем единицу на один из выводов порта B
out PORTB, sys; Вследствие чего загорается светодиод
rjmp Vix; Возврат в Vix
