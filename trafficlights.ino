unsigned long time_1 = 0;                    // Таймер горения сигнала
unsigned long time_0 = 0;                   // Таймер горения зеленого сигнала до мигания
unsigned long flshng;                          // Таймер мигания сигнала

                                                               // Распиновка подключения к микроконтроллеру
int RED = 7;                                         // Красный сигнал на 5 пине
int YEL = 6;                                         // Желтый сигнал на 6 пине
int GRE = 5;                                       // Зеленый сигнал на 7 пине
int BUZ = 9;                                      // Звуковой сигнал на 9 пине

                                                          // Время горения сигналов светофора в миллисекундах (1000мс = 1с)
unsigned long REDt = 60000;                      // 30 секунд
unsigned long YELt = 5000;                        // 5 секунд
unsigned long GREt = 55000;                    // 30 секунд

int FREQon = 1900;                             // Звучание при включеном сигнале
int FREQoff = 2100;                            // Звучание при выключенном сигнале

int flshng_freq = 500;                         // Периодичность мигания сигнала
int flshng_time = 20000;                   // Время мигания сигнала (20 секунд)

void setup()                                        // Выставление стартовых параметров
{
  pinMode(RED, OUTPUT);                  // Установим пин, как выход красного сигнала
  pinMode(YEL, OUTPUT);                  // Установим пин, как выход желтого сигнала
  pinMode(GRE, OUTPUT);                // Установим пин, как выход зеленого сигнала
  pinMode(BUZ, OUTPUT);               // Установим пин, как выход звукового сопровождения
  digitalWrite(RED, LOW);                // Подаем на пин "0"
  digitalWrite(YEL, LOW);                // Подаем на пин "0"
  digitalWrite(GRE, LOW);              // Подаем на пин "0"
}

void loop()                                  // Бесконечный цикл
{
 RED_SIG();                                  // Зажигаем красный сигнал
 YELLOW_SIG();                               // Зажигаем желтый сигнал
 GREEN_SIG();                                // Зажигаем зеленый сигнал
 YELLOW_SIG();                               // Зажигаем желтый сигнал
 }

void RED_SIG()                                 // Управление красным сигналом
{
  time_1 = millis() + REDt;                    // Определение точки срабатывания таймера горения сигнала
  digitalWrite(RED, HIGH);                     // Зажигание красного сигнала
  while (millis() <= time_1)                   // Выполняем пустой цикл, пока не выйдет время горения сигнала
    {
    }
  digitalWrite(RED, LOW);                      // Отключение красного сигнала
}

void YELLOW_SIG()                              // Управление желтым сигналом
{
  time_1 = millis() + YELt;                   // Определение точки срабатывания таймера горения сигнала
  digitalWrite(YEL, HIGH);                    // Зажигание желтого сигнала
  while (millis() <= time_1)                 // Выполняем пустой цикл, пока не выйдет время горения сигнала
    {
    }
  digitalWrite(YEL, LOW);                   // Отключение желтого сигнала
}

void GREEN_SIG()                            // Управление зеленым сигналом
{
 bool cnt = 0;                              // Выставление влага очередности
 digitalWrite(GRE, HIGH);                  // Зажигание зеленого сигнала
 tone(BUZ, FREQon);                        // Включение звукового сопровождения при включенном зеленом сигнале светофора

 time_0 = millis() + (GREt - flshng_time);  // Определение точки срабатывания таймера горения сигнала до мигания
 time_1 = millis() + GREt;                  // Определение новой точки срабатывания таймерагорения сигнала
 while (millis() <= time_0)
 {
 }
 noTone(BUZ);                            // Отключение звукового сопровождения
 flshng = millis() + flshng_freq;        // Определение точки срабатывания таймера мигания
 while (millis() <= time_1)                // Оставшееся время
 {
   if (millis() >= flshng)               // Если таймер мигания вышел
   {
     if (cnt == 1)                        // Через раз
     {
       digitalWrite(GRE, HIGH);          // Включать сигнал
       tone(BUZ, FREQon);                // Выводить звук
       flshng = millis() + flshng_freq;  // Определение новой точки срабатывания таймера мигания
       cnt = 0;
     }
     else
     {
       digitalWrite(GRE, LOW);           // Выключение сигнала
       tone(BUZ, FREQoff);               // Изменение тональности звукового сопровождения
       flshng = millis() + flshng_freq;  // Определение новой точки срабатывания таймера мигания
       cnt = 1;                          // Поменять флаг очередности
     }
   }
 }
 noTone(BUZ);                            // Отключить звуковое сопровождение
 digitalWrite(GRE, LOW);                 // Отключить зеленый сигнал
}